## Kconfig.projbuild
```kconfig
menu "EROS Configuration"

    config ENABLE_EROS_UDP
        bool "Enable EROS UDP"
        default y

    config EROS_UDP_PORT
        int "UDP Port"
        default 5555
        depends on ENABLE_EROS_UDP

    config ENABLE_EROS_TCP
        bool "Enable EROS TCP"
        default y

    config EROS_TCP_PORT
        int "TCP Port"
        default 6666
        depends on ENABLE_EROS_TCP

    config EROS_UART_BAUD
        int "UART Baudrate"
        default 2000000

    config EROS_TRACE_MODE_JSON
        bool "Send pbus traces in JSON format instead of CSV"
        default n

#TODO review which esp cores are actually dual cores, as these are the only ones that make sense
    config EROS_CPU_CORE
        int "Core Affinity"
        default -1
        range -1 1
        help
            Define on which core the eros code should be executed.
            In time critical applications it might be relevant to preserve a 'critical' cpu core.
            The default is '-1', which causes the system to determine the actual core to run the task.
            Check the docs on xTaskCreatePinnedToCore
endmenu
```
